## drivers/gpu/drm/axi_lcd/Kconfig
```kconfig
config DRM_AXI_LCD
	tristate "DRM Support for LCD panels on Xilinx FPGA platforms"
	depends on DRM
	default	n
	select DRM_KMS_HELPER
	select DRM_KMS_CMA_HELPER
	select VT_HW_CONSOLE_BINDING if FRAMEBUFFER_CONSOLE
```
